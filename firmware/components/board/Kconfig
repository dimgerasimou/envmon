## firmware/components/board/Kconfig
```kconfig
menu "Board"

	menu "I2C bus"

		config BOARD_I2C_SDA
			int "SDA GPIO"
			range 0 30
			default 6
			help
			  GPIO connected to the I2C data line.

		config BOARD_I2C_SCL
			int "SCL GPIO"
			range 0 30
			default 7
			help
			  GPIO connected to the I2C clock line.

	endmenu

	menu "Sensors"

		config BOARD_HAS_BMP280
			bool "BMP280 (temperature, pressure)"
			default n

		config BOARD_BMP280_ADDR
			hex "BMP280 I2C address"
			depends on BOARD_HAS_BMP280
			range 0x76 0x77
			default 0x76
			help
			  0x76 when SDO is tied to GND, 0x77 when tied to VCC.

		config BOARD_HAS_AHT10
			bool "AHT10 (temperature, humidity)"
			default n

		config BOARD_AHT10_ADDR
			hex "AHT10 I2C address"
			depends on BOARD_HAS_AHT10
			range 0x38 0x39
			default 0x38
			help
			  0x38 when ADR is tied to GND, 0x39 when tied to VCC.

		config BOARD_HAS_ENS160
			bool "ENS160 (air quality: AQI, TVOC, eCO2)"
			default n

		config BOARD_ENS160_ADDR
			hex "ENS160 I2C address"
			depends on BOARD_HAS_ENS160
			range 0x52 0x53
			default 0x53
			help
			  0x53 with ADDR tied to VCC (most modules), 0x52 to GND.

		config BOARD_HAS_SHT40
			bool "SHT40 (temperature, humidity)"
			default n

		config BOARD_SHT40_ADDR
			hex "SHT40 I2C address"
			depends on BOARD_HAS_SHT40
			range 0x44 0x45
			default 0x44
			help
			  0x44 for SHT40-AD1B (most modules), 0x45 for SHT40-BD1B.

		config BOARD_HAS_STCC4
			bool "STCC4 (CO2, plus temperature and humidity from its SHT4x)"
			default n

		config BOARD_STCC4_ADDR
			hex "STCC4 I2C address"
			depends on BOARD_HAS_STCC4
			range 0x64 0x65
			default 0x64
			help
			  Set by the address jumper on the DFRobot board.

		config BOARD_HAS_SEN66
			bool "SEN66 (PM, temperature, humidity, VOC, NOx, CO2)"
			default n
			help
			  Fixed address 0x6B. Needs 3.3 V and up to 350 mA peak.
	endmenu
endmenu
```

## firmware/main/Kconfig.projbuild
```kconfig
menu "envmon"

	config ENVMON_SENSOR_PERIOD_S
		int "Default sensor read period (seconds)"
		range 2 3600
		default 30
		help
		  Used until a period is saved from the console or Home Assistant.

	config ENVMON_PM_WARMUP_S
		int "Hide PM values after the SEN66 starts (seconds)"
		range 0 600
		default 120
		help
		  When its fan starts, the SEN66 blows out dust that settled inside
		  and the first PM readings are far too high (453 -> 27 ug/m3 over
		  90 s was seen). PM is reported as unknown for this long after every
		  (re)start of the sensor. 0 = report right away.

endmenu
```
